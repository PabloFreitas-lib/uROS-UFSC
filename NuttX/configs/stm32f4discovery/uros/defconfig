## NuttX/configs/tm4c123g-launchpad/uros/defconfig
```kconfig
# CONFIG_ARCH_FPU is not set
# CONFIG_NSH_ARGCAT is not set
# CONFIG_NSH_CMDOPT_HEXDUMP is not set
# CONFIG_NSH_CMDPARMS is not set
CONFIG_ARCH="arm"
CONFIG_ARCH_BOARD="tm4c123g-launchpad"
CONFIG_ARCH_BOARD_TM4C123G_LAUNCHPAD=y
CONFIG_ARCH_CHIP_TIVA=y
CONFIG_ARCH_CHIP_TM4C123=y
CONFIG_ARCH_CHIP_TM4C123GH6PMI=y
CONFIG_ARCH_CHIP_TM4C=y
CONFIG_ARCH_STACKDUMP=y
CONFIG_ARMV7M_OABI_TOOLCHAIN=y
CONFIG_ARMV7M_TOOLCHAIN_BUILDROOT=y
CONFIG_BOARD_LOOPSPERMSEC=4531
CONFIG_BUILTIN=y
CONFIG_DISABLE_POLL=y
CONFIG_MAX_TASKS=16
CONFIG_MAX_WDOGPARMS=2
CONFIG_NFILE_DESCRIPTORS=8
CONFIG_NFILE_STREAMS=8
CONFIG_NSH_ARCHINIT=y
CONFIG_NSH_BUILTIN_APPS=y
CONFIG_NSH_FILEIOSIZE=512
CONFIG_NSH_LINELEN=64
CONFIG_NSH_READLINE=y
CONFIG_PREALLOC_MQ_MSGS=4
CONFIG_PREALLOC_TIMERS=4
CONFIG_PREALLOC_WDOGS=4
CONFIG_RAM_SIZE=32768
CONFIG_RAM_START=0x20000000
CONFIG_RAW_BINARY=y
CONFIG_RR_INTERVAL=200
CONFIG_SCHED_WAITPID=y
CONFIG_START_DAY=24
CONFIG_START_MONTH=3
CONFIG_START_YEAR=2013
CONFIG_SYSTEM_NSH=y
CONFIG_TASK_NAME_SIZE=0
CONFIG_TIVA_GPIOA_IRQS=y
CONFIG_TIVA_GPIOB_IRQS=y
CONFIG_TIVA_GPIOC_IRQS=y
CONFIG_TIVA_GPIOD_IRQS=y
CONFIG_TIVA_GPIOE_IRQS=y
CONFIG_TIVA_GPIOF_IRQS=y
CONFIG_TIVA_GPIOP_IRQS=y
CONFIG_TIVA_SSI0=y
CONFIG_TIVA_UART0=y
CONFIG_UART0_SERIAL_CONSOLE=y
CONFIG_USER_ENTRYPOINT="nsh_main"
CONFIG_WDOG_INTRESERVE=0

# Enable C99 bool type
CONFIG_C99_BOOL8=y

# Enable uClibc++
CONFIG_UCLIBCXX=y

# Enable monotonic clock
CONFIG_CLOCK_MONOTONIC=y

# Enable uROS example
#CONFIG_UROS_EXAMPLES=y
CONFIG_UROS_EXAMPLES_PUBLISHER=y
#CONFIG_UROS_EXAMPLES_SUBSCRIBER=y
#CONFIG_UROS_EXAMPLES_MYAPP=y
#CONFIG_UROS_EXAMPLES_KOBUKI=y

# Select USART3
#CONFIG_STM32_USART3=y
#CONFIG_USART3_RXBUFSIZE=128
#CONFIG_USART3_TXBUFSIZE=512

# Enable TERMIOS
CONFIG_STANDARD_SERIAL=y
CONFIG_SERIAL_TERMIOS=y
CONFIG_DEV_CONSOLE=y

# Enable poll
CONFIG_DISABLE_POLL=n

# Enable UDP/TCP
CONFIG_ARCH_HAVE_NET=y
CONFIG_NET=y
CONFIG_NETDEVICES=y
CONFIG_NETDEV_LATEINIT=y
CONFIG_NET_UDP=y
CONFIG_NET_TCP=y

# Enable uROS
CONFIG_UROS=y

# Enable ACM console
CONFIG_USBDEV=y
#CONFIG_STM32_OTGFS=y
CONFIG_CDCACM=y
CONFIG_CDCACM_CONSOLE=y
CONFIG_CDCACM_RXBUFSIZE=256
CONFIG_CDCACM_TXBUFSIZE=256
CONFIG_NO_SERIAL_CONSOLE=y
CONFIG_LIB_BOARDCTL=y
CONFIG_BOARDCTL_USBDEVCTRL=y

# Enable debug
CONFIG_DEBUG_SYMBOLS=y

# Enable math library
CONFIG_LIBM=y
#CONFIG_ARCH_MATH_H=y # arch/math.h does not exist in nuttx/include/arch

# Enable float in printf
CONFIG_LIBC_FLOATINGPOINT=y

# Driver base import
CONFIG_UROS_DIR="../mcu_ws/"

# Imported
CONFIG_ARMV7M_TOOLCHAIN_GNU_EABIL=y

CONFIG_HAVE_CXX=y
CONFIG_HAVE_CXXINITIALIZE=y
```
